## build/conf/bblayers.conf
```bitbake
# POKY_BBLAYERS_CONF_VERSION is increased each time build/conf/bblayers.conf
# changes incompatibly
POKY_BBLAYERS_CONF_VERSION = "2"

BBPATH = "${TOPDIR}"
BBFILES ?= ""

BBLAYERS ?= " \
  ${TOPDIR}/../source/core/meta \
  ${TOPDIR}/../source/core/meta-poky \
  ${TOPDIR}/../source/core/meta-yocto-bsp \
  ${TOPDIR}/../source/meta-openembedded/meta-oe \
  ${TOPDIR}/../source/meta-openembedded/meta-python \
  ${TOPDIR}/../source/meta-openembedded/meta-networking \
  ${TOPDIR}/../source/meta-freescale \
  ${TOPDIR}/../source/meta-tq/meta-tq \
  ${TOPDIR}/../source/meta-openwrt \
  ${TOPDIR}/../source/meta-fixes \
  "
```
